## build/Kconfig/boards/Kconfig.nrf52_adafruit_feather
```kconfig
# Load board Kconfig descriptions.
osource "/opt/nordic/ncs/v3.0.2/zephyr/boards/adafruit/nrf52_adafruit_feather/Kconfig.nrf52_adafruit_feather"
```

## build/custom_target_6/Kconfig/arch/Kconfig
```kconfig
# Load Zephyr Arch Kconfig descriptions.
osource "/opt/nordic/ncs/v3.0.2/zephyr/arch/x86/Kconfig"
osource "/opt/nordic/ncs/v3.0.2/zephyr/arch/xtensa/Kconfig"
osource "/opt/nordic/ncs/v3.0.2/zephyr/arch/sparc/Kconfig"
osource "/opt/nordic/ncs/v3.0.2/zephyr/arch/riscv/Kconfig"
osource "/opt/nordic/ncs/v3.0.2/zephyr/arch/posix/Kconfig"
osource "/opt/nordic/ncs/v3.0.2/zephyr/arch/nios2/Kconfig"
osource "/opt/nordic/ncs/v3.0.2/zephyr/arch/mips/Kconfig"
osource "/opt/nordic/ncs/v3.0.2/zephyr/arch/arm64/Kconfig"
osource "/opt/nordic/ncs/v3.0.2/zephyr/arch/arm/Kconfig"
osource "/opt/nordic/ncs/v3.0.2/zephyr/arch/arc/Kconfig"
```
