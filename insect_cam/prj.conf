## CMakeLists.txt
```
# SPDX-License-Identifier: Apache-2.0

cmake_minimum_required(VERSION 3.20.0)

find_package(Zephyr REQUIRED HINTS $ENV{ZEPHYR_BASE})
project(custom_target_3)

target_sources(app PRIVATE 
src/main.c
src/ble_manager.c
src/HM01B0/HM01B0_CLK.c)
```

## prj.conf
```kconfig
CONFIG_I2C=y

CONFIG_GPIO=y

CONFIG_LOG=n

CONFIG_SERIAL=y
CONFIG_UART_ASYNC_API=y
CONFIG_UART_CONSOLE=y
CONFIG_UART_INTERRUPT_DRIVEN=y
CONFIG_RING_BUFFER=y

CONFIG_SPI=y
# Enable SPI slave (SPIS) driver support
CONFIG_SPI_SLAVE=y
CONFIG_SPI_NRFX=y
CONFIG_NRFX_PPI=y
CONFIG_NRFX_GPIOTE0=y
CONFIG_NRFX_GPPI=y
# Use the nrfx SPIS driver instance
CONFIG_NRFX_SPIS1=y


CONFIG_CORTEX_M_DEBUG_MONITOR_HOOK=y
CONFIG_SEGGER_DEBUGMON=y

# Increase stack and heap to accommodate large image buffers
CONFIG_MAIN_STACK_SIZE=4096
CONFIG_IDLE_STACK_SIZE=1024
CONFIG_SYSTEM_WORKQUEUE_STACK_SIZE=2048
CONFIG_HEAP_MEM_POOL_SIZE=10240

CONFIG_LOG=y
CONFIG_USE_SEGGER_RTT=y
CONFIG_LOG_BACKEND_RTT=y

CONFIG_PWM=y
CONFIG_DEVICE_MUTABLE=y

CONFIG_NRFX_TIMER3=y
CONFIG_NRFX_TIMER0=y

CONFIG_LOG_DEFAULT_LEVEL=3

# ==============BLE===============

CONFIG_BT=y
CONFIG_BT_PERIPHERAL=y
CONFIG_BT_DEVICE_NAME="insect_cam"
CONFIG_BT_MAX_CONN=1


# HCI ACL buffers size
CONFIG_BT_BUF_ACL_RX_SIZE=251

# L2CAP SDU/PDU TX MTU
CONFIG_BT_L2CAP_TX_MTU=247
```

## src/main.c
```c
/*
* HM01B0 capture example – interrupt driven, DMA-ready version
*
* Copyright (c) 2024 Open Pixel Systems
* SPDX-License-Identifier: Apache-2.0
*/

#include <zephyr/kernel.h>
#include <zephyr/device.h>
#include <zephyr/devicetree.h>
#include <zephyr/drivers/gpio.h>
#include <zephyr/drivers/i2c.h>
#include <zephyr/drivers/spi.h>
#include <zephyr/drivers/uart.h>
#include <zephyr/sys/printk.h>
#include <zephyr/sys/atomic.h>
#include <hal/nrf_power.h>
#include <hal/nrf_clock.h>

#include <hal/nrf_spis.h>
#include <nrfx_spis.h>
//#include <drivers/spi/spi_nrfx_spis.h>
#include <nrfx_gpiote.h>
#include <nrfx_ppi.h>
#include <helpers/nrfx_gppi.h>
#include <zephyr/drivers/pwm.h>
#include "HM01B0/HM01B0_def_values.h"
#include "HM01B0/HM01B0Regs.h"
#include "HM01B0/HM01B0_CLK.h"

/* -------------------------------------------------------------------------- */
/* Global objects                                                             */
/* -------------------------------------------------------------------------- */
__aligned(4)  /* EasyDMA friendly                                             */
static uint8_t image[IMAGE_SIZE];

/*  Compile-time test: linker may NOT move the buffer out of DMA RAM         */

static inline void hm_i2c_write(uint16_t reg, uint8_t val);

#define SPI_OP (SPI_WORD_SET(8) | SPI_OP_MODE_SLAVE | SPI_TRANSFER_MSB | SPI_MODE_CPOL | SPI_MODE_CPHA)

static struct spi_dt_spec spispec = SPI_DT_SPEC_GET(SPI_NODE, SPI_OP, 0);

//static const nrfx_spis_t spis = NRFX_SPIS_INSTANCE(1);



static const struct device *uart_dev   = DEVICE_DT_GET(UART_NODE);
static const struct i2c_dt_spec dev_i2c = I2C_DT_SPEC_GET(I2C_NODE);
static const struct device *gpio0_dev  = DEVICE_DT_GET(DT_NODELABEL(gpio0));

extern void run_peripheral_step( uint16_t seconds, uint8_t *image);
extern void init_ble();
/* -------------------------------------------------------------------------- */
/* Synchronisation primitives                                                 */
/* -------------------------------------------------------------------------- */
static struct k_sem  frame_sem;          /* “frame is ready” semaphore       */
static struct k_sem  line_sem;           /* given by SPIS END callback       */
static struct k_work start_capture_work;


/* A dedicated work-queue thread is faster than the system work-queue         */
#define LINE_THREAD_STACK_SZ 768
K_THREAD_STACK_DEFINE(line_stack, LINE_THREAD_STACK_SZ);
static struct k_thread line_thread_data;


static atomic_t capturing;
static uint8_t *current_dst;

/* Forward declaration */
static void arm_next_spis_transfer(void);


static void start_capture_fn(struct k_work *work)
{
    ARG_UNUSED(work);
    k_sem_give(&line_sem);
}

/* -------------------------------------------------------------------------- */
/* Worker thread – captures one line per iteration                            */
/* -------------------------------------------------------------------------- */
static void line_thread(void *p1, void *p2, void *p3)
{
    ARG_UNUSED(p1); ARG_UNUSED(p2); ARG_UNUSED(p3);
    
    while (true) {
        k_sem_take(&line_sem, K_FOREVER);     /* unblocked by SPIS END ISR   */

        if (!atomic_get(&capturing)) {
        continue;                         /* ignore stray events         */
    }

    /* Capture one line: wait for VSYNC event or previous DMA completion */
    arm_next_spis_transfer();


    /* Advance line index and write pointer for next line */
    atomic_inc(&line_idx);
    current_dst += IMG_WIDTH;

    /* If we've captured the last line, end frame */
    if (atomic_get(&line_idx) >= IMG_HEIGHT) {
        /* Copy the just-captured frame into a heap buffer and enqueue it */
        //printk("ploopt");
        atomic_clear(&capturing);
        k_sem_give(&frame_sem);
        }
    }
}

/* Arms SPIS for the next 240-byte DMA reception                              */
static void arm_next_spis_transfer(void)
{
if (IMG_WIDTH >= 2) {
        current_dst[0] = 0x00;
        current_dst[IMG_WIDTH - 1] = 0x00;
    }

    struct spi_buf rx = {
        .buf = (IMG_WIDTH > 2) ? (current_dst + 1) : current_dst,
        .len = (IMG_WIDTH > 2) ? (IMG_WIDTH - 2) : IMG_WIDTH
    };
    struct spi_buf_set rxset = { .buffers = &rx, .count = 1 };

//nrfx_spis_buffers_set(&spispec, NULL, 0, current_dst, IMG_WIDTH);
spi_transceive((&spispec)->bus, &(&spispec)->config, NULL, &rxset);
//gpio_pin_configure(gpio0_dev, 28, GPIO_OUTPUT_ACTIVE);
//spi_read_dt(&spispec, &rxset);
//gpio_pin_configure(gpio0_dev, 28, GPIO_OUTPUT_INACTIVE);
/*
uint32_t got = rx.len;
if (got != 160) {               
    printk("Line %3u: got %3lu bytes\n", (unsigned)atomic_get(&line_idx) - 1, (unsigned long)got);
}
    */
k_sem_give(&line_sem);
}



/* -------------------------------------------------------------------------- */
/* VSYNC ISR – starts a new frame                                             */
/* -------------------------------------------------------------------------- */
static struct gpio_callback vsync_cb;

static void vsync_isr(const struct device *dev,
    struct gpio_callback *cb,
    uint32_t pins)
    {
    if (gpio_pin_get(dev, PIN_VSYNC)) {          /* rising edge = frame start */
    atomic_set(&capturing, 1);
    atomic_set(&line_idx, 0);
    current_dst = image;
    
    
    k_sem_reset(&line_sem);                  /* flush stale grants        */
    /* Wake the line-capture thread so that it can start the very first
            * DMA transaction from thread context. Doing it here (ISR) would
            * violate Zephyr's rules because spi_read_dt() might sleep.        */
    //k_sem_give(&line_sem);
    k_work_submit(&start_capture_work);
    }
}

/* -------------------------------------------------------------------------- */
/* HM01B0 helper (unchanged)                                                   */
/* -------------------------------------------------------------------------- */
static inline void hm_i2c_write(uint16_t reg, uint8_t val)
{
uint8_t buf[] = { reg >> 8, reg & 0xff, val };
i2c_write_dt(&dev_i2c, buf, sizeof buf);
}

/* … init_cam() is identical to your original code …                         */

/* -------------------------------------------------------------------------- */
/* UART helper (unchanged)                                                    */
/* -------------------------------------------------------------------------- */

static void send_frame_over_uart_binary(void)
{
static const char hdr[]  = "<FRAME>\n";
static const char tail[] = "</FRAME>\n";

for (int i = 0; i < sizeof hdr - 1; i++)  uart_poll_out(uart_dev, hdr[i]);
for (size_t i = 0; i < IMAGE_SIZE; i++)
{
/*
    if(i%IMG_WIDTH == 0 || i%IMG_WIDTH-1 == 0) {
        continue;  skip first and last byte of each line 
    }
        */
    uart_poll_out(uart_dev, image[i]);
}   
for (int i = 0; i < sizeof tail - 1; i++) uart_poll_out(uart_dev, tail[i]);
}

/* -------------------------------------------------------------------------- */
/* main                                                                       */
/* -------------------------------------------------------------------------- */
void init_cam(void)
{



    hm_i2c_write( REG_MODE_SELECT, 0x00);//go to stand by mode
    //hm_i2c_write( REG_ANA_REGISTER_17, 0x00);//register to change the clk source(osc:1 mclk:0), if no mclk it goes to osc by default
    hm_i2c_write( REG_TEST_PATTERN_MODE, 0x00);//Enable the test pattern, set it to walking 1
    //hm_i2c_write(0x0101 , 0x03);
    
    hm_i2c_write( REG_BIN_MODE, 0x03);//VERTICAL BIN MODE
    hm_i2c_write( REG_QVGA_WIN_EN, 0x01);//Set line length LSB to QQVGA => enabled: makes the image 160(row)*240(col)
//    disable: image 160*320 //In test pattern mode, enabling this does not have any effect

    /*looking at lattice cfg setting*/
    //hm_i2c_write(0x0103,0x00);

    //100*100 optimization
    hm_i2c_write( REG_BIN_RDOUT_X, 0x03);//Horizontal Binning enable
    hm_i2c_write( REG_BIN_RDOUT_Y, 0x03);//vertical Binning enable => this register should be always 0x03 because we never go more than 160 for the height
        //frame timing control
    hm_i2c_write(REG_FRAME_LENGTH_PCK_H,0x00);
    hm_i2c_write(REG_FRAME_LENGTH_PCK_L,0xD7);//changed by Ali

    hm_i2c_write(REG_FRAME_LENGTH_LINES_H,0x00);//changed by Ali
    hm_i2c_write(REG_FRAME_LENGTH_LINES_L,0x80);//changed by Ali   

    /*looking at lattice cfg setting*/
    //hm_i2c_write(0x0103,0x00);
    hm_i2c_write(0x0104 ,0x01);
    /*
    hm_i2c_write(0x3044,0x0A);
    hm_i2c_write(0x3045,0x00);
    hm_i2c_write(0x3047,0x0A);
    hm_i2c_write(0x3050,0xC0);
    hm_i2c_write(0x3051,0x42);
//    hm_i2c_write(0x3052,0x50);
    hm_i2c_write(0x3053,0x00);
    hm_i2c_write(0x3054,0x03);
    hm_i2c_write(0x3055,0xF7);
    hm_i2c_write(0x3056,0xF8);
    hm_i2c_write(0x3057,0x29);
    hm_i2c_write(0x3058,0x1F);
//    hm_i2c_write(0x3059,0x1E);//bit control
    hm_i2c_write(0x3064,0x00);
    hm_i2c_write(0x3065,0x04);

    //black level control
    hm_i2c_write(0x1000,0x43);
    hm_i2c_write(0x1001,0x40);
    hm_i2c_write(0x1002,0x32);
    hm_i2c_write(0x1003,0x08);//default from lattice 0x08
    hm_i2c_write(0x1006,0x01);
    hm_i2c_write(0x1007,0x08);//default from lattice 0x08

    hm_i2c_write(0x0350,0x7F);
    

    //Sensor reserved
    hm_i2c_write(0x1008,0x00);
    hm_i2c_write(0x1009,0xA0);
    hm_i2c_write(0x100A,0x60);
    hm_i2c_write(0x100B,0x90);//default from lattice 0x90
    hm_i2c_write(0x100C,0x40);//default from lattice 0x40

    //Vsync, hsync and pixel shift register
//    hm_i2c_write(0x1012,0x07);//changed by Ali
    hm_i2c_write(0x1012,0x00);//lattice value

    //Statistic control and read only
    hm_i2c_write(0x2000,0x07);
    hm_i2c_write(0x2003,0x00);
    hm_i2c_write(0x2004,0x1C);
    hm_i2c_write(0x2007,0x00);
    hm_i2c_write(0x2008,0x58);
    hm_i2c_write(0x200B,0x00);
    hm_i2c_write(0x200C,0x7A);
    hm_i2c_write(0x200F,0x00);
    hm_i2c_write(0x2010,0xB8);
    hm_i2c_write(0x2013,0x00);
    hm_i2c_write(0x2014,0x58);
    hm_i2c_write(0x2017,0x00);
    hm_i2c_write(0x2018,0x9B);

    //Automatic exposure gain control
    
    hm_i2c_write(0x2101,0x70);//0x70);//lattice 0xA0
    hm_i2c_write(0x2102,0x06);//lattice 0x06
    hm_i2c_write(0x2104,0x07);
    hm_i2c_write(0x2105,0x03);
    hm_i2c_write(0x2106,0xA4);
    hm_i2c_write(0x2108,0x33);
    hm_i2c_write(0x210A,0x00);
    //hm_i2c_write(0x210C,0x04);
    hm_i2c_write(0x210B,0x80);
    hm_i2c_write(0x210F,0x00);
    hm_i2c_write(0x2110,0xE9);
    hm_i2c_write(0x2111,0x01);
    hm_i2c_write(0x2112,0x17);
    hm_i2c_write(0x2150,0x03);
*/
    //Sensor exposure gain
    hm_i2c_write(0x0205,0x00);//Vikram
    hm_i2c_write(0x020E,0x01);//Vikram
    hm_i2c_write(0x020F,0x00);//Vikram
    hm_i2c_write(0x0202,0x00);//Vikram
    hm_i2c_write(0x0203,0x30);//Vikram
    hm_i2c_write(0x2100,0x01);
    //frame timing control
//    hm_i2c_write(0x0340,0x02);//changed by Ali
//    hm_i2c_write(0x0341,0x32);//changed by Ali    
////    hm_i2c_write(0x0340,0x0C);
////    hm_i2c_write(0x0341,0x5C);
//
//    hm_i2c_write(0x0342,0x01);
//    hm_i2c_write(0x0343,0x78);//changed by Ali
//    hm_i2c_write(0x0343,0x78);

//    hm_i2c_write(0x3010,0x01); //done in lower lines
//    hm_i2c_write(0x0383,0x00); //done in lower lines
//    hm_i2c_write(0x0387,0x00); //done in lower lines
//    hm_i2c_write(0x0390,0x00); //done in lower lines
//    hm_i2c_write(0x3059,0x42); //done in lower lines
//    hm_i2c_write(0x3060,0x51); //done in lower lines
        //hm_i2c_write( REG_OSC_CLK_DIV, 0x30);//This is effective when we use external clk, Use the camera in the gated clock mode to make the clock zero when there is no data

        hm_i2c_write( REG_BIT_CONTROL, 0x20);//Set the output to send 1 bit serial
        //hm_i2c_write(0x3062, 0xFF);
        //hm_i2c_write(0x0202, 0x00);
        //hm_i2c_write(0x0203, 0x08);
        //hm_i2c_write(0x2101, 0x06);
        //hm_i2c_write(0x2105, 0x01);
        hm_i2c_write(0x3060, 0x30);
        hm_i2c_write(0x1012, 0x03);
        //hm_i2c_write(0x3023, 0x05);
        //hm_i2c_write(0x0101 , 0x02);

        //hm_i2c_write( REG_PMU_PROGRAMMABLE_FRAMECNT, 0x01);//set the number of frames to be sent out, it sends N frames
        

        //hm_clk_enable(true);
}

/* -------------------------------------------------------------------------- */
/* Scope‑pin helper – toggles P0.17 on every SPIS1 EVENTS_END via PPI         */
/* -------------------------------------------------------------------------- */
static void scope_pin_init(void)
{
    /* 1) P0.17 as output driven by GPIOTE task                                */
    NRF_GPIO->DIRSET = 1UL << PIN_OUT;
    NRF_GPIOTE->CONFIG[GPIOTE_CH] = (GPIOTE_CONFIG_MODE_Task << GPIOTE_CONFIG_MODE_Pos) |
                                    (PIN_OUT                 << GPIOTE_CONFIG_PSEL_Pos) |
                                    (GPIOTE_CONFIG_POLARITY_Toggle << GPIOTE_CONFIG_POLARITY_Pos);

    /* 2) Route SPIS1 EVENTS_END to that task via PPI channel 0                */
    NRF_PPI->CH[PPI_CH].EEP = (uint32_t)&NRF_SPIS1->EVENTS_END;
    NRF_PPI->CH[PPI_CH].TEP = (uint32_t)&NRF_GPIOTE->TASKS_OUT[GPIOTE_CH];

    /* 3) Enable the PPI channel                                              */
    NRF_PPI->CHENSET = 1UL << PPI_CH;
}


void gate_trigger_init(void)
{
        NRF_GPIO->PIN_CNF[PIN_GATE] =
            (GPIO_PIN_CNF_DIR_Input      << GPIO_PIN_CNF_DIR_Pos)  |
            (GPIO_PIN_CNF_INPUT_Connect  << GPIO_PIN_CNF_INPUT_Pos)|
            (GPIO_PIN_CNF_PULL_Pullup  << GPIO_PIN_CNF_PULL_Pos);

        NRF_GPIOTE->CONFIG[GPIOTE_CH_GATE] =
            (GPIOTE_CONFIG_MODE_Event     << GPIOTE_CONFIG_MODE_Pos) |
            (PIN_GATE                     << GPIOTE_CONFIG_PSEL_Pos) |
            (GPIOTE_CONFIG_POLARITY_HiToLo<< GPIOTE_CONFIG_POLARITY_Pos);

        /* 2) Route the event to TASKS_ACQUIRE */
        NRF_PPI->CH[PPI_CH_GATE].EEP = (uint32_t)&NRF_GPIOTE->EVENTS_IN[GPIOTE_CH_GATE];
        NRF_PPI->CH[PPI_CH_GATE].TEP = (uint32_t)&NRF_SPIS1->TASKS_ACQUIRE;

        /* 3) Enable the PPI channel */
        NRF_PPI->CHENSET = 1UL << PPI_CH_GATE;
}


/* -------------------------------------------------------------------------- */
/* Release helper – SPIS1 RELEASE fires when HSYNC (LVLD) falls               */
/* -------------------------------------------------------------------------- */
static void release_trigger_init(void)
{
    /* 1) Configure PIN_HSYNC as input (it already is) and generate an event on Hi→Lo */
    NRF_GPIO->PIN_CNF[PIN_HSYNC] =
          (GPIO_PIN_CNF_DIR_Input      << GPIO_PIN_CNF_DIR_Pos)  |
          (GPIO_PIN_CNF_INPUT_Connect  << GPIO_PIN_CNF_INPUT_Pos)|
          (GPIO_PIN_CNF_PULL_Pulldown  << GPIO_PIN_CNF_PULL_Pos);
    NRF_GPIOTE->CONFIG[GPIOTE_CH_HSYNC] =
          (GPIOTE_CONFIG_MODE_Event      << GPIOTE_CONFIG_MODE_Pos) |
          (PIN_HSYNC                      << GPIOTE_CONFIG_PSEL_Pos) |
          (GPIOTE_CONFIG_POLARITY_HiToLo  << GPIOTE_CONFIG_POLARITY_Pos);

    /* 2) Route the event to TASKS_RELEASE */
    NRF_PPI->CH[PPI_CH_REL].EEP = (uint32_t)&NRF_GPIOTE->EVENTS_IN[GPIOTE_CH_HSYNC];
    NRF_PPI->CH[PPI_CH_REL].TEP = (uint32_t)&NRF_SPIS1->TASKS_RELEASE;

    /* 3) Enable PPI channel */
    NRF_PPI->CHENSET = 1UL << PPI_CH_REL;
}






/* Now send_frame_over_uart_binary(); */

//static const struct pwm_dt_spec servo = PWM_DT_SPEC_GET(DT_NODELABEL(servo));

int main(void)
{
    printk("hello");
//uint32_t pulse_width = 222;
//int ret = pwm_set_pulse_dt(&servo, pulse_width);
//ret = pwm_set_dt(&servo, 200, 200 / 2U);
//k_yield();
/* once at boot, right after spis init */
hm_clk_out();
k_msleep(100);


/* leave this on forever */
//spispec.config = spi_cfg_pwr1;
__ASSERT(((uintptr_t)image) >= DMA_RAM_START &&((uintptr_t)image + IMAGE_SIZE) <= DMA_RAM_END, "image[] must live in the first 64 kB of SRAM (EasyDMA)");
if (!device_is_ready(uart_dev)      ||
    !device_is_ready(dev_i2c.bus)   ||
    !device_is_ready(spispec.bus)   ||
    !device_is_ready(gpio0_dev)) {
    printk("Device not ready\n");
    return -ENODEV;
}
//printk("poop");

/* Keep the system in constant‑latency mode to avoid first‑byte corruption */
NRF_POWER->TASKS_CONSTLAT = 1;

/* Start the high‑frequency crystal so SPIS always samples with HFCLK */
NRF_CLOCK->TASKS_HFCLKSTART = 1;
while (NRF_CLOCK->EVENTS_HFCLKSTARTED == 0) {
}
NRF_CLOCK->EVENTS_HFCLKSTARTED = 0;

/* Enable END→ACQUIRE shortcut once the SPIS driver has been initialised */
/* Enable END→ACQUIRE shortcut once the SPIS driver has been initialised */
{
    NRF_SPIS_Type *spis =
        (NRF_SPIS_Type *)DT_REG_ADDR(DT_NODELABEL(spi1));  /* SPIS1 base */
    spis->SHORTS |= SPIS_SHORTS_END_ACQUIRE_Msk;
}

scope_pin_init();
gate_trigger_init();
release_trigger_init();
//test poop
/* Create semaphores after driver init so ISR may use them immediately    */
k_sem_init(&frame_sem, 0, 1);
k_sem_init(&line_sem,  0, 1);
k_work_init(&start_capture_work, start_capture_fn);

/* Spawn dedicated line-capture thread                                    */
k_thread_create(&line_thread_data, line_stack, LINE_THREAD_STACK_SZ,
                line_thread, NULL, NULL, NULL,
                K_PRIO_PREEMPT(0), 0, K_NO_WAIT);

init_cam();

/* --- VSYNC pin -------------------------------------------------------- */
gpio_pin_configure(gpio0_dev, PIN_VSYNC, GPIO_INPUT | GPIO_PULL_DOWN);
gpio_init_callback(&vsync_cb, vsync_isr, BIT(PIN_VSYNC));
gpio_add_callback(gpio0_dev, &vsync_cb);
gpio_pin_interrupt_configure(gpio0_dev, PIN_VSYNC, GPIO_INT_EDGE_RISING);
/* --- CSN pin -------------------------------------------------------- */
        uint8_t addr_readback[2];
        uint8_t val;

        /* BIT_CONTROL should read back 0x20 for 1-bit serial mode. */
        addr_readback[0] = 0x03; addr_readback[1] = 0x50;
        if (i2c_write_read_dt(&dev_i2c, addr_readback, 2, &val, 1) == 0)
            printk("QVGA win (0x0350) = 0x%02X\n", val);

        /* OSC_CLK_DIV should read back 0x00 (MSB-first, ÷8, non-gated). */
        addr_readback[0] = 0x03; addr_readback[1] = 0x81;
        if (i2c_write_read_dt(&dev_i2c, addr_readback, 2, &val, 1) == 0)
            printk("BIN_RDOUT_Y (0x0381) = 0x%02X\n", val);

        /* TEST_PATTERN_MODE – should be 0x00 (disabled) */
        addr_readback[0] = 0x10; addr_readback[1] = 0x06;
        if (i2c_write_read_dt(&dev_i2c, addr_readback, 2, &val, 1) == 0)
            printk("IMG_MODE_SEL (0x1006) = 0x%02X\n", val);
/* ------------------------- main loop ---------------------------------- */
//hm_i2c_write(REG_MODE_SELECT, 0x03);
//k_sem_take(&frame_sem, K_FOREVER);
//return -1;
init_ble();
while (true) {
    hm_i2c_write(REG_MODE_SELECT, 0x03);
    //gpio_add_callback(gpio0_dev, &vsync_cb);
    //hm_i2c_write(REG_MODE_SELECT, 0x03);   /* start streaming  */
    k_sem_take(&frame_sem, K_FOREVER);     /* wait for 1 frame */
    //gpio_remove_callback(gpio0_dev, &vsync_cb);
    //hm_i2c_write(REG_MODE_SELECT, 0x00);   /* standby          */
    hm_i2c_write(REG_MODE_SELECT, 0x00);
    //send_frame_over_uart_binary();
    run_peripheral_step(0, image);
    }   
}
```

## src/ble_manager.c
```c
/*
 * Copyright (c) 2023 Nordic Semiconductor ASA
 *
 * SPDX-License-Identifier: Apache-2.0
 * 
 * Author: tekritesh@github.com
 */

#include <zephyr/bluetooth/gatt.h>
#include <zephyr/kernel.h>
#include <stddef.h>
#include <stdint.h>
#include <zephyr/sys/printk.h>

#include <zephyr/bluetooth/bluetooth.h>
#include <zephyr/bluetooth/conn.h>
#include <zephyr/bluetooth/uuid.h>
#include <zephyr/sys/util.h>
#include "HM01B0/HM01B0_def_values.h"

#define BT_UUID_IMG_SERVICE_VAL \
    BT_UUID_128_ENCODE(0x6e400001, 0xb5a3, 0xf393, 0xe0a9, 0xe50e24dcca3e)
#define BT_UUID_IMG_RX_VAL \
    BT_UUID_128_ENCODE(0x6e400002, 0xb5a3, 0xf393, 0xe0a9, 0xe50e24dcca3e)
#define BT_UUID_IMG_TX_VAL \
    BT_UUID_128_ENCODE(0x6e400003, 0xb5a3, 0xf393, 0xe0a9, 0xe50e24dcca3e)
#define BT_UUID_IMG_INFO_VAL \
    BT_UUID_128_ENCODE(0x6e400004, 0xb5a3, 0xf393, 0xe0a9, 0xe50e24dcca3e)

/* Overhead: opcode (u8) + handle (u16) */
#define ATT_NTF_SIZE(payload_len) (1 + 2 + payload_len)

// #define IMG_WIDTH  160
// #define IMG_HEIGHT 119
// extern uint8_t image[];

#define CHUNK_SIZE CONFIG_BT_L2CAP_TX_MTU




// BLE Characteristics
static const struct bt_uuid_128 insect_cam_service = BT_UUID_INIT_128(BT_UUID_IMG_SERVICE_VAL);

static const struct bt_uuid_128 tx_characteristic_uuid = BT_UUID_INIT_128(BT_UUID_IMG_TX_VAL);

static const struct bt_uuid_128 rx_characteristic_uuid = BT_UUID_INIT_128(BT_UUID_IMG_RX_VAL);

static const struct bt_uuid_128 img_info_characteristic_uuid = BT_UUID_INIT_128(BT_UUID_IMG_INFO_VAL);

static const struct bt_data adv_ad_data[] = {
	BT_DATA_BYTES(BT_DATA_FLAGS, (BT_LE_AD_GENERAL | BT_LE_AD_NO_BREDR)),
	BT_DATA_BYTES(BT_DATA_UUID128_ALL, BT_UUID_IMG_SERVICE_VAL),
	BT_DATA(BT_DATA_NAME_COMPLETE, CONFIG_BT_DEVICE_NAME, sizeof(CONFIG_BT_DEVICE_NAME) - 1),
};


// BLE Variables
static struct bt_conn *default_conn;
static struct k_sem conn_sem;
static struct k_work advertise_work;


//Defing dummy data buffer and stream specific variables
// static uint8_t data_to_send[1000];
uint16_t ble_mtu =0;
// bool stream_en = false;
uint8_t tx_state = 0;

bool char_tx = false;
bool notif_state[2] = {false, false};

static ssize_t on_rx_received(struct bt_conn *conn,
                              const struct bt_gatt_attr *attr,
                              const void *buf,
                              uint16_t len,
                              uint16_t offset,
                              uint8_t flags);

static void send_large_data(struct bt_conn *conn, uint8_t *image);   

static const struct bt_gatt_attr *notify_attr_global = NULL;



void advertising_work_handler(struct k_work *work) {
	bt_le_adv_start(BT_LE_ADV_CONN_ONE_TIME, adv_ad_data, ARRAY_SIZE(adv_ad_data), NULL, 0);
}

static void ccc_cfg_changed_tx(const struct bt_gatt_attr *attr, uint16_t value) {
    bool notif_enabled = (value == BT_GATT_CCC_NOTIFY);
    notif_state[1] = notif_enabled;
    printk("Tx Notifications %s\n", notif_enabled ? "enabled" : "disabled");

}

static void ccc_cfg_changed_img_info(const struct bt_gatt_attr *attr, uint16_t value) {
    bool notif_enabled = (value == BT_GATT_CCC_NOTIFY);
    notif_state[0] = notif_enabled;
    printk("Img Info Notifications %s\n", notif_enabled ? "enabled" : "disabled");

}
         
BT_GATT_SERVICE_DEFINE(
    insect_cam,
    BT_GATT_PRIMARY_SERVICE(&insect_cam_service),
    BT_GATT_CHARACTERISTIC(&tx_characteristic_uuid.uuid,(BT_GATT_CHRC_NOTIFY), (BT_GATT_PERM_NONE), NULL, NULL, NULL),
    BT_GATT_CCC(ccc_cfg_changed_tx, BT_GATT_PERM_READ | BT_GATT_PERM_WRITE),
    BT_GATT_CHARACTERISTIC(&img_info_characteristic_uuid.uuid,(BT_GATT_CHRC_NOTIFY), (BT_GATT_PERM_NONE), NULL, NULL, NULL),
    BT_GATT_CCC(ccc_cfg_changed_img_info, BT_GATT_PERM_READ | BT_GATT_PERM_WRITE),
    BT_GATT_CHARACTERISTIC(&rx_characteristic_uuid.uuid,(BT_GATT_CHRC_WRITE_WITHOUT_RESP | BT_GATT_CHRC_WRITE), BT_GATT_PERM_WRITE, NULL, on_rx_received, NULL)
    );

static void send_large_data(struct bt_conn *conn, uint8_t *image) {
    if (!conn){
        printk("No active connection\n");
        return;
    }

    notify_attr_global = bt_gatt_find_by_uuid(insect_cam.attrs, 0xffff, &tx_characteristic_uuid.uuid);

    if (!notify_attr_global) {
        printk("Tx Notify attribute not found!\n");
        return;
    }
    
    uint16_t max_payload = ble_mtu - 3;  // ATT notification overhead

    // size_t img_size = IMG_WIDTH*IMG_HEIGHT;

    uint16_t offset = 0;
    uint16_t counter = 0;

    // if(notif_state[1]){ //ensure that the Tx Notif is Enabled

        while(offset < IMAGE_SIZE){
            uint16_t len = MIN(max_payload, IMAGE_SIZE - offset);
            
            int err = bt_gatt_notify(conn, notify_attr_global, &image[offset], len);
            if (err) {
                printk("Img Tx Notify failed: %d\n", err);
                tx_state = 0;
                    // return;
            }else{
                printk("Tx pkt:i[%d] L[%d] S[%d]\n",counter,len,offset);
            }
            
            k_sleep(K_MSEC(1));
            counter++;
            offset +=len;

        }
    counter = 0;

    // } else {
        
        // printk("Unable to Enable Tx Notifications\n");
        // return;
    // }
    
}


static ssize_t on_rx_received(struct bt_conn *conn,
                              const struct bt_gatt_attr *attr,
                              const void *buf,
                              uint16_t len,
                              uint16_t offset,
                              uint8_t flags) {
    printk("RX received %d bytes -->", len);

    const uint8_t *rx_data = buf;
    for (uint8_t i = 0; i< len; i++){
        printk("%x",rx_data[i]);
    }
    printk("\n");

    char_tx = true;


    if (len == 1 && rx_data[0] == 1){
        tx_state = 1;
        printk("Enabling Single Image..\n");
        // send_large_data(conn);
    }

    if (len == 1 && rx_data[0] == 2){
        printk("Enabling Stream..\n");
        tx_state = 2;
        // send_large_data(conn);
    }

    if(len == 1 && rx_data[0] == 3){ 
        printk("Disabling Stream..\n");
        tx_state = 0;

    }

    return len;
}



void mtu_updated(struct bt_conn *conn, uint16_t tx, uint16_t rx) {
	printk("Updated MTU: TX: %d RX: %d bytes\n", tx, rx);
}

static struct bt_gatt_cb gatt_callbacks = {
	.att_mtu_updated = mtu_updated,
};

static void connected(struct bt_conn *conn, uint8_t err) {
	if (err != 0) {
		return;
	}

	default_conn = bt_conn_ref(conn);
	k_sem_give(&conn_sem);
}

static void disconnected(struct bt_conn *conn, uint8_t reason) {
	bt_conn_unref(conn);
	default_conn = NULL;
	k_work_submit(&advertise_work);
}

BT_CONN_CB_DEFINE(conn_callbacks) = {
	.connected = connected,
	.disconnected = disconnected,
};

void init_ble(){

    int err;

	err = bt_enable(NULL);
	if (err) {
		printk("Bluetooth init failed (err %d)\n", err);
		return;
	}

	k_sem_init(&conn_sem, 0, 1);
	bt_gatt_cb_register(&gatt_callbacks);

	k_work_init(&advertise_work, advertising_work_handler);

    
	bt_le_adv_start(BT_LE_ADV_CONN_ONE_TIME, adv_ad_data, ARRAY_SIZE(adv_ad_data), NULL, 0);
	

    

}

void run_peripheral_step( uint16_t seconds, uint8_t *image) {

    // int err;

	// err = bt_enable(NULL);
	// if (err) {
	// 	printk("Bluetooth init failed (err %d)\n", err);
	// 	return;
	// }

	// k_sem_init(&conn_sem, 0, 1);
	// bt_gatt_cb_register(&gatt_callbacks);

	// k_work_init(&advertise_work, advertising_work_handler);

    
	// bt_le_adv_start(BT_LE_ADV_CONN_ONE_TIME, adv_ad_data, ARRAY_SIZE(adv_ad_data), NULL, 0);
	

	// bool infinite = seconds == 0;

    // struct bt_gatt_attr *img_info_notify_attr_global = bt_gatt_find_by_uuid(insect_cam.attrs, 0xffff, &img_info_characteristic_uuid.uuid);

    // if (!img_info_notify_attr_global) {
    //     printk("Img Info notify attribute not found!\n");
    //     return;
    // }
    struct bt_gatt_attr *img_info_notify_attr_global = bt_gatt_find_by_uuid(insect_cam.attrs, 0xffff, &img_info_characteristic_uuid.uuid);

    if (!img_info_notify_attr_global) {
        printk("Img Info notify attribute not found!\n");
        return;
    }

	// for (int i = 0; (i < seconds) || infinite; i++) {
		if (default_conn == NULL) {
			k_sem_take(&conn_sem, K_FOREVER);
		}

		// k_sleep(K_MSEC(5));
		if (default_conn == NULL) {
			printk("Idle,Ready to Pair....\n");
            ble_mtu = 0;
            tx_state = 0;
		/* Only send the notification if the UATT MTU supports the required length */
		} else {
            

            // if (notif_state[0]){ //Ensure that the IMG Info Notif is Enabled
                
                uint16_t current_mtu = bt_gatt_get_uatt_mtu(default_conn);
                
                if ((char_tx == true )|| (current_mtu != ble_mtu)){
                    ble_mtu = current_mtu;
                    char_tx = false;
                    uint8_t img_info[7] = {tx_state,current_mtu & 0xFF,(current_mtu >> 8) & 0xFF,24 & 0xFF,(24 >> 8) & 0xFF,1,1};
                    int err = bt_gatt_notify(default_conn, img_info_notify_attr_global, &img_info, 7);
                    if (err) {
                        printk("Img Information Notify failed: %d\n", err);
                    }else{
                        printk("Tx pkt:tx[%d] mtu[%d]\n",tx_state,current_mtu);
                    }
                }

            // }else{
                    // printk("Unable to Enable Img Info Notifications\n
                    // return;
            
            // }
            
            if(tx_state == 2){
                send_large_data(default_conn, image);
            }
            
		}
	// }
}
```
